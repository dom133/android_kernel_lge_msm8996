## drivers/input/touchscreen/lge/lgsic/Kconfig
```kconfig
#
# LGE touch core configuration
#
if INPUT_TOUCHSCREEN

menuconfig LGE_TOUCH_LGSIC_SW49410
        bool "LGE Touch Core ODM Device Driver - SW49410"
        depends on LGE_TOUCH_CORE_BASE
        help
          If your device is sw49410, say Y

menuconfig LGE_TOUCH_SPI_MAX_SPEED_CHK
        bool "LGE Touch SPI Max Speed Check - SW49410"
        depends on LGE_TOUCH_CORE_BASE
        help
          If your device is sw49410, say Y


# To Do : LGSIC Chipseet
endif
```
